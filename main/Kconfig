## main/Kconfig
```kconfig
menu "EcoWatt Settings"

config ECOWATT_WIFI_SSID
    string "Wi-Fi SSID"
    default "YOUR_WIFI_SSID"

config ECOWATT_WIFI_PASS
    string "Wi-Fi Password"
    default "YOUR_WIFI_PASSWORD"

config ECOWATT_API_BASE_URL
    string "Inverter SIM Base URL"
    default "http://20.15.114.131:8080"

config ECOWATT_API_KEY_B64
    string "Inverter SIM API key (Authorization header - e.g., 'Basic <base64>')"
    default ""

config ECOWATT_CLOUD_BASE_URL
    string "EcoWatt Cloud Base URL (HTTP/HTTPS)"
    default "http://192.168.8.195:5000"  

config ECOWATT_CLOUD_KEY_B64
    string "EcoWatt Cloud API key (Authorization header - e.g., 'Basic <base64>')"
    default ""

config ECOWATT_UPLOAD_INTERVAL_SEC
    int "Upload interval seconds (15 demo / 900 real)"
    range 5 3600
    default 15

config ECOWATT_SAMPLE_PERIOD_MS
    int "Sampling period (ms)"
    range 100 90000
    default 5000

config ECOWATT_SLEEP_FEATURE_THRESHOLD_MS
    int "Minimum sample period (ms) to enable sleep features"
    range 100 900000
    default 90000

config ECOWATT_DEVICE_ID
    string "Device ID"
    default "EcoWatt-Dev-01"

config ECOWATT_PSK
    string "Pre-shared key for HMAC (PSK)"
    default "ecowatt-demo-psk"

config ECOWATT_USE_ENVELOPE
    bool "Use HMAC envelope for device↔cloud"
    default y

config ECOWATT_MANUAL_LIGHT_SLEEP
    bool "Allow manual light-sleep between sampling ticks"
    default y

config ECOWATT_ENABLE_AUTO_LIGHT_SLEEP
    bool "Enable automatic light-sleep via ESP power manager"
    default y

config ECOWATT_SAFE_MIN_SLEEP_MS
    int "Safe minimal sleep window (ms) for manual light-sleep"
    range 0 1000
    default 50

config ECOWATT_WIFI_GATE_BETWEEN_UPLOADS
    bool "Stop/start Wi‑Fi between uploads when beneficial"
    default n

config ECOWATT_WIFI_GATE_MIN_INTERVAL_SEC
    int "Minimum upload interval (sec) to allow Wi‑Fi gating"
    range 5 86400
    default 30

config ECOWATT_POWER_V_SUPPLY
    int "Assumed supply voltage (mV) for energy estimation"
    default 5000

config ECOWATT_POWER_I_ACTIVE_MA
    int "Assumed device active current (mA) for energy estimation"
    default 200

config ECOWATT_POWER_I_UPLINK_MA
    int "Assumed uplink/network burst current (mA) for energy estimation"
    default 300

config ECOWATT_POWER_I_SLEEP_MA
    int "Assumed light-sleep current (mA) for energy estimation"
    default 5

endmenu
```

## main/Kconfig.projbuild
```kconfig
menu "EcoWatt Settings"

    config ECOWATT_WIFI_SSID
        string "Wi-Fi SSID"
        default "YOUR_WIFI_SSID"

    config ECOWATT_WIFI_PASS
        string "Wi-Fi Password"
        default "YOUR_WIFI_PASSWORD"

    config ECOWATT_API_BASE_URL
        string "Inverter SIM Base URL"
        default "http://20.15.114.131:8080"

    config ECOWATT_API_KEY_B64
        string "Inverter SIM API key (Base64 user:pass)"
        default ""

    config ECOWATT_CLOUD_BASE_URL
        string "EcoWatt Cloud Base URL (HTTP/HTTPS)"
        default "http://192.168.65.146:5000"

    config ECOWATT_CLOUD_KEY_B64
        string "EcoWatt Cloud API key (Base64 user:pass)"
        default ""

    config ECOWATT_UPLOAD_INTERVAL_SEC
        int "Upload interval seconds (15 demo / 900 real)"
        range 5 3600
        default 15

    config ECOWATT_SAMPLE_PERIOD_MS
        int "Sampling period (ms)"
        range 100 60000
        default 5000

    config ECOWATT_DEVICE_ID
        string "Device ID"
        default "EcoWatt-Dev-01"

endmenu
```
